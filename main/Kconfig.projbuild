## main/Kconfig.projbuild
```kconfig
menu "ESPDrone Config"

    choice
        prompt "ESP_Drone hardware version"
        default TARGET_ESP32_S2_DRONE_V1_2

        config TARGET_ESP32_S2_DRONE_V1_2
            bool "esp-drone with ESP32-S2 onboard"

    endchoice

    menu "app set"
        config ENABLE_LEGACY_APP
            bool "Enable legacy ESPlane1.0 APP"
            default n
            help
                This enables the udp_server_rx2_task of wifi.
    endmenu

    menu "wireless config"
        config WIFI_BASE_SSID
            string "Wi-Fi Base SSID"
            default "ESP-DRONE"
            help
                Wi-Fi Base SSID, 1-16 characters. the final SSID will be BASE_SSID-MAC
        config WIFI_PASSWORD
            string "Wi-Fi Password"
            default "12345678"
            help
                Wi-Fi Password, 8-64 characters
        config WIFI_CHANNEL
            int "Wi-Fi Channel"
            range 1 13
            default 6
            help
                Wi-Fi Channel, 1-13
        config WIFI_MAX_STA_CONN
            int "Wi-Fi Max Station Connection"
            range 1 6
            default 3
            help
                Wi-Fi Max Station Connection, 1-6
    endmenu

    menu "calibration angle"
        config PITCH_CALIB
            int "PITCH_CALIB deg*100"
            range -200 200
            default 0
            help
                if PITCH error angle is 0.90,set this 90

        config ROLL_CALIB
            int "ROLL_CALIB deg*100"
            range -200 200
            default 0
            help
                if ROLL error angle is 0.90,set this 90
    endmenu

    menu "system"

        config BASE_STACK_SIZE
            int "base stack size for system task"
            range 512 1024
            default 512

    endmenu

    menu "sensors config"
        config I2C0_PIN_SDA
            int "I2C0_PIN_SDA GPIO number"
            range 0 43
            default 11
            help
                GPIO number (IOxx) I2C0_PIN_SDA

        config I2C0_PIN_SCL
            int "I2C0_PIN_SCL GPIO number"
            range 0 43
            default 10
            help
                GPIO number (IOxx) I2C0_PIN_SCL

        config I2C1_PIN_SDA
            int "I2C1_PIN_SDA GPIO number"
            range 0 43
            default 40
            help
                GPIO number (IOxx) I2C1_PIN_SDA

        config I2C1_PIN_SCL
            int "I2C1_PIN_SCL GPIO number"
            range 0 43
            default 41
            help
                GPIO number (IOxx) I2C1_PIN_SCL

        config MPU_PIN_INT
            int "MPU_PIN_INT GPIO number"
            range 0 43
            default 12
            help
                GPIO number (IOxx) MPU_PIN_INT
    endmenu

    menu "led config"
        config LED_PIN_BLUE
            int "LED_PIN_BLUE GPIO number"
            range 0 43
            default 7
            help
                GPIO number (IOxx) LED_PIN_BLUE

        config LED_PIN_GREEN
            int "LED_PIN_GREEN GPIO number"
            range 0 43
            default 9
            help
                GPIO number (IOxx) LED_PIN_GREEN

        config LED_PIN_RED
            int "LED_PIN_RED GPIO number"
            range 0 43
            default 8
            help
                GPIO number (IOxx) LED_PIN_RED

    endmenu

    menu "motors config"
        choice
            prompt "Motor type"
            default MOTOR_BRUSHED_720

            config MOTOR_BRUSHED_715
                bool "brushed 715 motor"

            config MOTOR_BRUSHED_720
                bool "brushed 720 motor"
        endchoice

        config MOTOR01_PIN
            int "MOTOR01_PIN GPIO number"
            range 0 43
            default 5
            help
                GPIO number (IOxx) MOTOR01_PIN

        config MOTOR02_PIN
            int "MOTOR02_PIN GPIO number"
            range 0 43
            default 6
            help
                GPIO number (IOxx) MOTOR02_PIN

        config MOTOR03_PIN
            int "MOTOR03_PIN GPIO number"
            range 0 43
            default 3
            help
                GPIO number (IOxx) MOTOR03_PIN

        config MOTOR04_PIN
            int "MOTOR04_PIN GPIO number"
            range 0 43
            default 4
            help
                GPIO number (IOxx) MOTOR04_PIN
    endmenu


endmenu
```
